/*

  Clock.ino
  
  Demonstrates a clock-like display with a very huge font.
  Also shows usage of u8x8_u8toa().

  Universal 8bit Graphics Library (https://github.com/olikraus/u8g2/)

  Copyright (c) 2016, olikraus@gmail.com
  All rights reserved.

  Redistribution and use in source and binary forms, with or without modification, 
  are permitted provided that the following conditions are met:

  * Redistributions of source code must retain the above copyright notice, this list 
    of conditions and the following disclaimer.
    
  * Redistributions in binary form must reproduce the above copyright notice, this 
    list of conditions and the following disclaimer in the documentation and/or other 
    materials provided with the distribution.

  THIS SOFTWARE IS PROVIDED BY THE COPYRIGHT HOLDERS AND 
  CONTRIBUTORS "AS IS" AND ANY EXPRESS OR IMPLIED WARRANTIES, 
  INCLUDING, BUT NOT LIMITED TO, THE IMPLIED WARRANTIES OF 
  MERCHANTABILITY AND FITNESS FOR A PARTICULAR PURPOSE ARE 
  DISCLAIMED. IN NO EVENT SHALL THE COPYRIGHT HOLDER OR 
  CONTRIBUTORS BE LIABLE FOR ANY DIRECT, INDIRECT, INCIDENTAL, 
  SPECIAL, EXEMPLARY, OR CONSEQUENTIAL DAMAGES (INCLUDING, BUT 
  NOT LIMITED TO, PROCUREMENT OF SUBSTITUTE GOODS OR SERVICES; 
  LOSS OF USE, DATA, OR PROFITS; OR BUSINESS INTERRUPTION) HOWEVER 
  CAUSED AND ON ANY THEORY OF LIABILITY, WHETHER IN CONTRACT, 
  STRICT LIABILITY, OR TORT (INCLUDING NEGLIGENCE OR OTHERWISE) 
  ARISING IN ANY WAY OUT OF THE USE OF THIS SOFTWARE, EVEN IF 
  ADVISED OF THE POSSIBILITY OF SUCH DAMAGE.  

*/

#include <Arduino.h>

#include <time.h>

#include <SPI.h>

#include <Wire.h>




#define RTC_ENABLE false //set to true if using real time clock module
#define LCD_18 false //set to true if using 1.8" LCD module
#define LCD_22 true //set to true if using 2.2" LCD module
#define WIFI_ENABLED true

#define D0 16
#define D1 5
#define D2 4
#define D3 0
#define D4 2
#define D5 14
#define D6 12
#define D7 13
#define D8 15


#if LCD_18 == true
  #include <Adafruit_GFX.h>    // Core graphics library
  #include <Adafruit_ST7735.h> // Hardware-specific library for ST7735
  #include <Fonts/FreeSerifBold24pt7b.h>
  #include <Fonts/FreeSerif9pt7b.h>
  #define TFT_CS D8
  #define TFT_RST D4
  #define TFT_DC D3
  #define TFT_SCLK D5
  #define TFT_MOSI D7
  #define BL D6 
  #define FONT_SMALL 
  #define FONT_LARGE
  
  Adafruit_ST7735 tft = Adafruit_ST7735(TFT_CS, TFT_DC, TFT_RST); // defines the comms object
#elif LCD_22 == true
  #include "TFT_22_ILI9225.h"
  #include <../fonts/FreeSerifBold24pt7b.h>
  #include <../fonts/FreeSerif9pt7b.h>
  #define TFT_RST D1
  #define TFT_RS  D2
  #define TFT_CS  D0  // SS
  #define TFT_SDI D3  // MOSI
  #define TFT_CLK D4  // SCK
  #define TFT_LED D5   // 0 if wired to +5V directly
  TFT_22_ILI9225 tft = TFT_22_ILI9225(TFT_RST, TFT_RS, TFT_CS, TFT_SDI, TFT_CLK, TFT_LED);
#endif

#if RTC_ENABLE == true
  #include <RTClib.h>
  RTC_DS3231 Clock;
#endif

#if WIFI_ENABLED == true 
  #include <ESP8266WiFi.h>
  #include <NTPClient.h>
  #include <WiFiUdp.h>
  unsigned int localPort = 2390;      // local port to listen for UDP packets
  WiFiUDP ntpUDP;
  NTPClient timeClient(ntpUDP);
#endif


#define  BLACK   0x0000
#define BLUE    0x001F
#define RED     0xF800
#define GREEN   0x07E0
#define CYAN    0x07FF
#define MAGENTA 0xF81F
#define YELLOW  0xFFE0
#define WHITE   0xFFFF
#define MINUTE_COL GREEN
#define HOUR_COL MAGENTA
#define FONT_BIG 1
#define FONT_SMALL 0

uint16_t FG_COLOR;
uint16_t BG_COLOR;

bool Century=false;
bool h12 = false;
bool PM = false;




char ssid[] = "PrettyFlyForAWifi";  //  your network SSID (name)
char pass[] = "gy3UwuaJPcAv";       // your network password

String dateStr;
String lastDateStr;
String timeStr;
String lastTimeStr;

unsigned int 
  seconds = 0, secondsOld = 0,
  minutes = 30, minutesOld = 0,
  hour = 11, hourOld = 0;

uint8_t hourAnalog;

int w,h;

int x = 64, y = 90, r = 50, sr, mr, hr,
    sx = 0, sy = 0,
    mx = 0, my = 0,
    hx = 0, hy = 0;

float a;  




const unsigned char landrover [] PROGMEM = {
  // 'lanbdrover, 128x160px
  0x00, 0x00, 0x00, 0x00, 0x00, 0x00, 0x00, 0x00, 0x00, 0x00, 0x00, 0x00, 0x00, 0x00, 0x00, 0x00, 
  0x00, 0x00, 0x00, 0x00, 0x00, 0x00, 0x00, 0x00, 0x00, 0x00, 0x00, 0x00, 0x00, 0x00, 0x00, 0x00, 
  0x00, 0x00, 0x00, 0x00, 0x00, 0x00, 0x00, 0x00, 0x00, 0x00, 0x00, 0x00, 0x00, 0x00, 0x00, 0x00, 
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  0x00, 0x00, 0x00, 0x00, 0x00, 0x00, 0x00, 0x00, 0x00, 0x00, 0x00, 0x00, 0x00, 0x00, 0x00, 0x00
};

const unsigned char landythumb [] PROGMEM = {
   0x00,0x00,0x00,0x00,0x00,0x00,0x00,0x00,0xc0,0x00,0x00,0x00,
 0x00,0x00,0x00,0x00,0x00,0xc0,0x00,0x00,0x00,0xff,0xff,0x3f,
 0x00,0x00,0xc0,0x00,0x00,0xf8,0xff,0xff,0xff,0x0f,0x00,0xc0,
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 0x00,0x00,0xc0,0x00,0x00,0x00,0x00,0x00,0x00,0x00,0x00,0xc0
};

word ConvertRGB( byte R, byte G, byte B)
{
  return ( ((R & 0xF8) << 8) | ((G & 0xFC) << 3) | (B >> 3) );
}

void blankScreen(void){
  #if LCD_18
    tft.fillScreen(BG_COLOR);
  #else
    tft.clear();
  #endif
}

void setBacklight(void){
  #if LCD_18    
    analogWrite(BL,analogRead(A0)/4);
  #endif
}



void setup(void) { 
  Serial.begin(115200); 
  Serial.print("setup");
  FG_COLOR = 0xFFFF;
  BG_COLOR = ConvertRGB(0x03,0x36,0x05);
  sr = r;
  mr = r;
  hr = r-15;

  #if LCD_18
    tft.initR(INITR_BLACKTAB);      // Init ST7735S chip, black tab
    pinMode(BL, OUTPUT); 
  #endif
  #if LCD_22
    tft.begin();
  #endif
  Serial.print("setup");
  blankScreen();
  tft.drawBitmap(0, 0, landrover, 128, 160, FG_COLOR );
  
  #if WIFI_ENABLED  
    //try to connect to wifi for 5 seconds    
    WiFi.mode(WIFI_STA);
    WiFi.begin(ssid, pass); 
    
    int i = 0;
    while (WiFi.status() != WL_CONNECTED && i < 10) {
      delay(500);
      Serial.print(".");
      i++;
    }
  #endif
  #if RTC_ENABLED
    if (!Clock.begin()) {
      Serial.println("Couldn't find RTC");
      while (1);
    }
    if (Clock.lostPower()) {
      Serial.println("RTC lost power, lets set the time!");
      // following line sets the RTC to the date & time this sketch was compiled
      Clock.adjust(DateTime(F(__DATE__), F(__TIME__)));    
    }
  #endif
  blankScreen();
  
}

#if WIFI_ENABLED
  void updateCurrentTimeFromNTP(){
     timeClient.begin();
    while(!timeClient.update()) {
      timeClient.forceUpdate();
    }
    time_t rawtime = timeClient.getEpochTime();
    struct tm * ti;
    ti = localtime (&rawtime);
  
    uint16_t year = ti->tm_year;
   
  
    uint8_t month = ti->tm_mon + 1;
  
  
    uint8_t day = ti->tm_mday;
   
  
    uint8_t hour = ti->tm_hour;
  
  
    minutes = ti->tm_min;  
   
  
    seconds = ti->tm_sec;
  }
#endif

#if RTC_ENABLED
  void updateCurrentTimeFromRTC(){
     DateTime now = Clock.now();
     Serial.print("Reading time \r\n"); 
     uint16_t year = now.year();
     String yearStr = String(year);
  
     uint8_t month = now.month();
     String monthStr = month < 10 ? "0" + String(month) : String(month);
  
     uint8_t day = now.day();
     String dayStr = day < 10 ? "0" + String(day) : String(day);
  
     uint8_t hour = now.hour();
     hourAnalog = hour;
     if (hourAnalog > 12)
        hourAnalog = hourAnalog - 12;
     String hoursStr = hour < 10 ? "0" + String(hour) : String(hour);
  
     minutes = now.minute();
     String minutesStr = minutes < 10 ? "0" + String(minutes) : String(minutes);
  
     seconds = now.second();
     String secondStr = seconds < 10 ? "0" + String(seconds) : String(seconds);
  
     timeStr = hoursStr + ":" + minutesStr;
     dateStr = dayStr + "/" + monthStr;
  }
#endif

void updateCurrentTime(void){
  #if RTC_ENABLED
    updateCurrentTimeFromRTC();
  #elif WIFIENABLED
    updateCurrentTimeFromNTP();
  #endif
}

void drawSegment(int x, int y, int r1, int r2, float a, int col)
{
  a = (a / 57.2958) - 1.57; 
  float a1 = a-1.57,
      a2 = a+1.57,
      x1 = x + (cos(a1) * r1),
      y1 = y + (sin(a1) * r1),
      x2 = x + (cos(a2) * r1),
      y2 = y + (sin(a2) * r1),
      x3 = x + (cos(a) * r2),
      y3 = y + (sin(a) * r2);
      
  tft.fillTriangle(x1,y1,x2,y2,x3,y3,col);
}


void drawAnalogueTime(void)
{
  
  
  //drawSegment(x, y, 8, hr, 30*hourAnalog, HOUR_COL);
  //drawSegment(x, y, 6, mr, 6*minutes, MINUTE_COL);  
  
  
  a = ((30 * hourAnalog) / 57.2958) - 1.570; 
  hx = x + (cos(a) * hr);
  hy = y + (sin(a) * hr);
  tft.drawLine(x, y, hx, hy, HOUR_COL);

  a = ((6 * minutes) / 57.2958) - 1.570; 
  mx = x + (cos(a) * mr);
  my = y + (sin(a) * mr);
  tft.drawLine(x, y, mx, my, MINUTE_COL);

}

void putTextOnLCD(int cursorX, int cursorY, int font_size, String text){
  #if LCD_18
    if (font_size == FONT_BIG){
      tft.setFont(&FreeSerifBold24pt7b)
    } else {
      tft.setFont(&FreeSerif9pt7b); 
    }
    tft.setCursor(cursorX,cursorY);
    tft.print(text); 
  #endif

  #if LCD_22
     if (font_size == FONT_BIG){
        tft.setGFXFont(&FreeSerifBold24pt7b);        
      } else {
         tft.setGFXFont(&FreeSerif9pt7b);
      }
       tft.drawGFXText(cursorX, cursorY, text, FG_COLOR);  
  #endif
}

void drawDigitalTime(void){
  blankScreen();
  putTextOnLCD(8,40,FONT_BIG,timeStr);
  putTextOnLCD(2,155,FONT_SMALL,dateStr);
}

void drawDisplay(void){
  Serial.print("updateDisplay");
  if (timeStr != lastTimeStr){
    drawDigitalTime();
    drawAnalogueTime();
    lastTimeStr = timeStr;
  }
}


void loop(void) {
  setBacklight();
  //readTime();
  drawDisplay();
  delay(1000);
  
}

